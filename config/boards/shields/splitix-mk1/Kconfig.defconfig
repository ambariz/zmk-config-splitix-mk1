## config/boards/shields/splitix-mk1/Kconfig.defconfig
```kconfig
if SHIELD_SPLITIX_MK1_LEFT || SHIELD_SPLITIX_MK1_RIGHT

config ZMK_SPLIT
    default y

endif

if SHIELD_SPLITIX_MK1_LEFT

config ZMK_SPLIT_ROLE_CENTRAL
    default y

endif
```

## config/boards/shields/splitix-mk1/Kconfig.shield
```kconfig
config SHIELD_SPLITIX_MK1_LEFT
    bool "Splitix MK1 Left Half"
    depends on (BOARD_NICE_NANO_V2 || BOARD_NICE_NANO)

config SHIELD_SPLITIX_MK1_RIGHT
    bool "Splitix MK1 Right Half"
    depends on (BOARD_NICE_NANO_V2 || BOARD_NICE_NANO)
```
